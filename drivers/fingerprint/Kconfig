## drivers/fingerprint/Kconfig
```kconfig
menuconfig BBK_FINGERPRINT
	tristate "BBK FINGERPRINT support"
	help
	  Say Y here to enable fingerprint

if BBK_FINGERPRINT
config BBK_FP_MODULE
	bool "BBK fingerprint modules"
	help
		Say Y here to enable fingerprint modules
config BBK_FP_ID
	tristate "detect fingerprint id"
	help
	  there is nothing for help!

source "drivers/fingerprint/fpc1552/Kconfig"
source "drivers/fingerprint/gf3956/Kconfig"
source "drivers/fingerprint/icnf7312/Kconfig"
source "drivers/fingerprint/gf9578/Kconfig"
endif
```

## drivers/fingerprint/gf9578/Kconfig
```kconfig
config BBK_GF9578
	tristate "Goodix GF9518 fingerprint drvier support"
	help
	  Say Y here to enable goodix fingerprint driver support!
```

## drivers/nfc/sn100/Kconfig
```kconfig
config NFC_SN100
	tristate "QTI NCI based NFC Controller Driver for SN100x"
	depends on I2C
	help
	  NXP SN100 core driver.
	  This driver provides core functionality for NXP SN100 NFC devices.

config SN100_SPI
	tristate "sn100 NFC spi clk control"
	default n
```

## drivers/sensorhub_monitor/Kconfig
```kconfig
config SENSORHUB_MONITOR
	tristate "SENSORHUB_MONITOR support"
	help
	  Say M here to enable switch class support. This allows
	  monitoring scp subsystem
```
